## drivers/misc/ameba_npu/Kconfig
```kconfig
# SPDX-License-Identifier: Apache-2.0

config AMEBA_NPU
	bool "Realtek Ameba NPU Driver"
	default n

config NPU_AMEBAPRO2
	bool "Realtek AmebaPro2 NPU driver"
	depends on AMEBA_NPU && DT_HAS_REALTEK_AMEBAPRO2_NPU_ENABLED
	default y
	select CACHE_MANAGEMENT
	help
	  Enable the Zephyr-facing Ameba NPU API wrapper.

if NPU_AMEBAPRO2

module = AMEBA_NPU
module-str = ameba_npu
source "subsys/logging/Kconfig.template.log_config"

config AMEBA_NPU_MODEL_FLASH_LOADER
	bool "Ameba NPU flash model loader"
	default n
	help
	  Load .nb NPU model images from the NN_MDL flash partition, for use
	  by applications running NPU inference.

config AMEBA_NPU_YOLOV4_TINY_POSTPROCESS
	bool "YOLOv4-tiny NPU output tensor postprocessing"
	default n
	help
	  Decode YOLOv4-tiny NPU output tensors (box decode + class-aware
	  DIoU-NMS) into detected objects, for use by applications running
	  NPU inference.

config AMEBA_NPU_SCRFD_POSTPROCESS
	bool "SCRFD NPU output tensor postprocessing"
	default n
	help
	  Decode SCRFD NPU output tensors (box decode + NMS) into detected
	  faces, for use by applications running NPU inference.

endif # NPU_AMEBAPRO2
```

## dts/bindings/misc/realtek,amebapro2-npu.yaml
```yaml
# Copyright (c) 2026 Realtek Semiconductor Corp.
# SPDX-License-Identifier: Apache-2.0

description: |
  Realtek AmebaPro2 NPU frontend.

  The Zephyr device instance describes the board-specific NPU register base and
  interrupt line.

compatible: "realtek,amebapro2-npu"

include: [base.yaml]

properties:
  reg:
    required: true

  interrupts:
    required: true
```

## dts/bindings/video/realtek,amebapro2-video-channel.yaml
```yaml
# Copyright (c) 2024 Realtek Semiconductor Corp.
# SPDX-License-Identifier: Apache-2.0

description: Amebapro2 Video Channel

compatible: "realtek,amebapro2-video-channel"

include: [base.yaml]

properties:
  reg:
    required: true

  interrupts:
    required: true

  label:
    required: true

  default-width:
    type: int
    description: Default frame width in pixels

  default-height:
    type: int
    description: Default frame height in pixels

  default-fps:
    type: int
    description: Default frame rate

  default-video-type:
    type: int
    description: >
      Default encode type. Use constants from
      dt-bindings/video/amebapro2_video.h:
      AMEBAPRO2_VIDEO_TYPE_HEVC, _H264, _JPEG, _NV12, _RGB.

  default-out-mode:
    type: int
    description: >
      VOE output mode. Use constants from
      dt-bindings/video/amebapro2_video.h:
      AMEBAPRO2_VIDEO_OUT_MODE_DEFAULT or _CONTINUOUS.
```
