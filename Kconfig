## Kconfig
```kconfig
# Copyright (c) 2024 Realtek Semiconductor Corp.
# SPDX-License-Identifier: Apache-2.0

menu "AmebaPro2 Platform"

rsource "drivers/Kconfig"

endmenu
```

## drivers/Kconfig
```kconfig
# SPDX-License-Identifier: Apache-2.0

rsource "serial/Kconfig"
rsource "entropy/Kconfig"
rsource "pinctrl/Kconfig"
rsource "spi/Kconfig"
rsource "flash/Kconfig"
rsource "i2c/Kconfig"
rsource "gpio/Kconfig"
rsource "disk/Kconfig"
rsource "video/Kconfig"
rsource "audio/Kconfig"
```

## drivers/adc/Kconfig
```kconfig
# SPDX-License-Identifier: Apache-2.0

if ADC

rsource "Kconfig.amebapro2"

endif # ADC
```

## drivers/adc/Kconfig.amebapro2
```kconfig
# Copyright (c) 2024 Realtek Semiconductor Corp.
# SPDX-License-Identifier: Apache-2.0

config ADC_AMEBAPRO2
	bool "Ameba ADC driver"
	default y
	depends on DT_HAS_REALTEK_AMEBAPRO2_ADC_ENABLED
	help
	  Enable the driver implementation for the Ameba ADC
```

## drivers/audio/Kconfig
```kconfig
# SPDX-License-Identifier: Apache-2.0

if AUDIO_DMIC

rsource "Kconfig.amebapro2_dmic"

endif # AUDIO_DMIC
```

## drivers/disk/Kconfig
```kconfig
# SPDX-License-Identifier: Apache-2.0

if DISK_DRIVERS

rsource "Kconfig.sdmmc_amebapro2"

endif # DISK_DRIVERS
```

## drivers/flash/Kconfig
```kconfig
# SPDX-License-Identifier: Apache-2.0

if FLASH

rsource "Kconfig.amebapro2"

endif # FLASH
```

## drivers/gpio/Kconfig
```kconfig
# SPDX-License-Identifier: Apache-2.0

if GPIO

rsource "Kconfig.amebapro2"

endif # GPIO
```

## drivers/i2c/Kconfig
```kconfig
# SPDX-License-Identifier: Apache-2.0

if I2C

rsource "Kconfig.amebapro2"

endif # I2C
```

## drivers/pinctrl/Kconfig
```kconfig
# SPDX-License-Identifier: Apache-2.0

if PINCTRL

rsource "Kconfig.amebapro2"

endif # PINCTRL
```

## drivers/pwm/Kconfig
```kconfig
# SPDX-License-Identifier: Apache-2.0

if PWM

rsource "Kconfig.amebapro2"

endif # PWM
```

## drivers/pwm/Kconfig.amebapro2
```kconfig
# AMEBA PWM configuration options

# Copyright (c) 2024 Realtek Semiconductor Corp.
# SPDX-License-Identifier: Apache-2.0

config PWM_AMEBAPRO2
	bool "AMEBA PWM driver"
	default y
	depends on DT_HAS_REALTEK_AMEBAPRO2_PWM_ENABLED
	help
	  Enable the PWM driver for AMEBA family of processors.
```

## drivers/serial/Kconfig
```kconfig
# SPDX-License-Identifier: Apache-2.0

if SERIAL

rsource "Kconfig.amebapro2_loguart"

endif # SERIAL
```

## drivers/spi/Kconfig
```kconfig
# SPDX-License-Identifier: Apache-2.0

if SPI

rsource "Kconfig.amebapro2"

endif # SPI
```

## drivers/video/Kconfig
```kconfig
# SPDX-License-Identifier: Apache-2.0

if VIDEO

rsource "Kconfig.amebapro2"

endif # VIDEO
```

## dts/bindings/adc/realtek,amebapro2-adc.yaml
```yaml
# Copyright (c) 2024 Realtek Semiconductor Corp.
# SPDX-License-Identifier: Apache-2.0

description: AMEBAPRO2 ADC

compatible: "realtek,amebapro2-adc"

include: [adc-controller.yaml, base.yaml, pinctrl-device.yaml]

properties:
  reg:
    required: true

  "#io-channel-cells":
    const: 1

io-channel-cells:
  - input
```

## dts/bindings/pwm/realtek,amebapro2-pwm.yaml
```yaml
# Copyright (c) 2024 Realtek Semiconductor Corp.
# SPDX-License-Identifier: Apache-2.0

description: AMEBAPRO2 PWM

compatible: "realtek,amebapro2-pwm"

include: [pwm-controller.yaml, base.yaml, pinctrl-device.yaml]

properties:
  reg:
    required: true

pwm-cells:
  - channel
  - period
  - flags
```
